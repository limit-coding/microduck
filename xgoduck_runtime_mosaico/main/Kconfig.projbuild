## xgoduck_runtime_mosaico/main/Kconfig.projbuild
```kconfig
menu "Duck RL deployment"
config DUCK_WIFI_SSID
    string "Wi-Fi SSID"
    default "XGO2"
config DUCK_WIFI_PASSWORD
    string "Wi-Fi password"
    default "LuwuDynamics"
config DUCK_IP_UART_TX
    int "UART0 IP report TX GPIO (115200 baud)"
    range 0 60
    default 15
config DUCK_IP_UART_RX
    int "UART0 IP report RX GPIO"
    range 0 60
    default 16
config DUCK_ROBOT_UART_TX
    int "UART1 robot TX GPIO"
    range 0 60
    default 46
config DUCK_ROBOT_UART_RX
    int "UART1 robot RX GPIO"
    range 0 60
    default 39
config DUCK_WEB_PORT
    int "HTTP port"
    range 1 65535
    default 80
endmenu
```

## xgoduck_runtime_mosaico/sdkconfig.defaults
```kconfig
CONFIG_IDF_TARGET="esp32s31"
CONFIG_ESPTOOLPY_FLASHSIZE_4MB=y
CONFIG_PARTITION_TABLE_CUSTOM=y
CONFIG_PARTITION_TABLE_CUSTOM_FILENAME="partitions.csv"
CONFIG_COMPILER_OPTIMIZATION_PERF=y
CONFIG_ESP_DEFAULT_CPU_FREQ_MHZ_320=y
CONFIG_FREERTOS_HZ=1000
CONFIG_ESP_CONSOLE_USB_SERIAL_JTAG=y
CONFIG_ESP_CONSOLE_SECONDARY_NONE=y
CONFIG_BOOTLOADER_LOG_LEVEL_NONE=y
CONFIG_ESP_MAIN_TASK_STACK_SIZE=8192
CONFIG_LWIP_MAX_SOCKETS=10
CONFIG_DUCK_IP_UART_TX=15
CONFIG_DUCK_IP_UART_RX=16
CONFIG_DUCK_ROBOT_UART_TX=46
CONFIG_DUCK_ROBOT_UART_RX=39
CONFIG_SPIRAM=y
CONFIG_SPIRAM_MODE_OCT=y
CONFIG_SPIRAM_SPEED_200M=y
CONFIG_SPIRAM_BOOT_INIT=y
CONFIG_SPIRAM_USE_CAPS_ALLOC=y
CONFIG_SPIRAM_IGNORE_NOTFOUND=y
```
